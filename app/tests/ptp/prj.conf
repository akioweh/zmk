## CMakeLists.txt
```
# Copyright (c) 2026 The ZMK Contributors
# SPDX-License-Identifier: MIT

cmake_minimum_required(VERSION 3.13.1)
# Core tests must not load keyboard-specific West modules/drivers.
set(ZEPHYR_MODULES "${CMAKE_CURRENT_SOURCE_DIR}")
list(APPEND DTS_ROOT "${CMAKE_CURRENT_SOURCE_DIR}/../..")
find_package(Zephyr REQUIRED HINTS $ENV{ZEPHYR_BASE})
project(ptp_core)
target_include_directories(app PRIVATE ../../include ../../src/ptp)
target_sources(app PRIVATE src/queue.c ../../src/ptp/frame.c ../../src/ptp/split.c)
target_compile_definitions(app PRIVATE CONFIG_ZMK_LOG_LEVEL=0)
if(CONFIG_ZMK_SPLIT_ROLE_CENTRAL)
  target_sources(app PRIVATE src/main.c ../../src/ptp/ptp.c ../../src/split/wired/wired.c)
  target_sources_ifdef(CONFIG_ZMK_PTP_TOUCH app PRIVATE ../../src/ptp/touch.c)
else()
  target_sources(app PRIVATE src/peripheral.c)
endif()
# Mock three BLE profiles without starting a Bluetooth controller.
target_compile_definitions(app PRIVATE CONFIG_BT_MAX_PAIRED=3)
```

## Kconfig
```
# Copyright (c) 2026 The ZMK Contributors
# SPDX-License-Identifier: MIT

mainmenu "PTP core tests"

# These transport flags enable mocked backend calls, not real USB/Bluetooth.
config ZMK_USB
    bool
    default y

config ZMK_BLE
    bool
    default y

config ZMK_SPLIT
    bool
    default y

config ZMK_SPLIT_ROLE_CENTRAL
    bool "Split central test variant"
    default y

config ZMK_POINTING
    bool
    default y if ZMK_SPLIT_ROLE_CENTRAL
    select INPUT

config ZMK_TRACKPAD_PHYSICAL_X
    default 500

config ZMK_TRACKPAD_PHYSICAL_Y
    default 500

rsource "../../src/ptp/Kconfig"
source "Kconfig.zephyr"
```

## prj.conf
```kconfig
CONFIG_ZTEST=y
CONFIG_RING_BUFFER=y
CONFIG_CRC=y
CONFIG_IRQ_OFFLOAD=y
CONFIG_ZMK_TRACKPAD=y
```

## compat.conf
```kconfig
CONFIG_ZMK_BLE_PTP_FEATURE_PAD_BYTE=y
CONFIG_ZMK_BLE_PTP_PACING=n
```

## firmware.conf
```kconfig
# Compile-only interface exercise; dimensions are synthetic, not sensor calibration.
CONFIG_ZMK_TRACKPAD=y
CONFIG_ZMK_TRACKPAD_LOGICAL_X=4095
CONFIG_ZMK_TRACKPAD_LOGICAL_Y=4095
CONFIG_ZMK_TRACKPAD_PHYSICAL_X=500
CONFIG_ZMK_TRACKPAD_PHYSICAL_Y=500
```

## peripheral-firmware.conf
```kconfig
# Compile-only generic contact API; no sensor producer is enabled.
CONFIG_ZMK_TRACKPAD=y
```

## app.overlay
```dts
/ {
    ptp_touch_test: ptp_touch {
        compatible = "zmk,ptp-touch";
    };
};
```

## src/peripheral.c
```c
/*
 * Copyright (c) 2026 The ZMK Contributors
 *
 * SPDX-License-Identifier: MIT
 */
#include <errno.h>
#include <zephyr/irq_offload.h>
#include <zephyr/ztest.h>
#include <zmk/ptp/split.h>
#include <zmk/split/peripheral.h>

static struct zmk_split_transport_peripheral_event events[64];
static int count, error;

int zmk_activity_note(void) { return 0; }

int zmk_split_peripheral_report_event(const struct zmk_split_transport_peripheral_event *event) {
    if (error) {
        return error;
    }
    zassert_true(count < ARRAY_SIZE(events));
    events[count++] = *event;
    return 0;
}

static struct zmk_ptp_frame one(void) {
    return (struct zmk_ptp_frame){.scan_time = 0xffff,
                                  .contact_count = 1,
                                  .contacts = {{.id = 4, .x = 123, .y = 456, .confidence = true}},
                                  .buttons = 7};
}

static struct zmk_ptp_frame last(uint16_t *sequence) {
    struct zmk_ptp_frame frame;
    zassert_true(count > 0);
    zassert_equal(events[count - 1].type, ZMK_SPLIT_TRANSPORT_PERIPHERAL_EVENT_TYPE_CONTACT_FRAME);
    zassert_ok(zmk_ptp_split_decode(&events[count - 1].data.contact_frame, sequence, &frame));
    return frame;
}

static void before(void *fixture) {
    error = 0;
    zassert_ok(zmk_ptp_release());
    k_sleep(K_MSEC(160)); /* Drain the idle retries. */
    count = 0;
}

ZTEST(ptp_peripheral, test_uniform_api_one_atomic_event) {
    struct zmk_ptp_frame frame = one();
    frame.contact_count = 5;
    for (int i = 0; i < 5; i++) {
        frame.contacts[i] =
            (struct zmk_ptp_contact){.id = i, .x = 123 + i, .y = 456, .confidence = i != 3};
    }
    zassert_ok(zmk_ptp_submit_frame(&frame));
    zassert_equal(count, 1); /* Not twenty scalar input events. */
    uint16_t sequence;
    struct zmk_ptp_frame received = last(&sequence);
    zassert_equal(received.contact_count, 5);
    zassert_equal(received.scan_time, 0xffff);
    zassert_equal(received.buttons, 7);
    zassert_equal(received.contacts[4].x, 127);
    zassert_false(received.contacts[3].confidence);
    frame.contacts[4].x = 999; /* Submission copied the snapshot. */
    k_sleep(K_MSEC(70));
    uint16_t heartbeat_sequence;
    received = last(&heartbeat_sequence);
    zassert_equal(heartbeat_sequence, sequence);
    zassert_equal(received.contacts[4].x, 127);
}

ZTEST(ptp_peripheral, test_offline_lift_replaces_cached_hold) {
    struct zmk_ptp_frame frame = one();
    zassert_ok(zmk_ptp_submit_frame(&frame));
    uint16_t sequence;
    last(&sequence);
    error = -ENODEV;
    zassert_equal(zmk_ptp_release(), -ENODEV);
    k_sleep(K_MSEC(70));
    error = 0;
    zmk_ptp_split_resume();
    k_sleep(K_MSEC(20));
    uint16_t resumed_sequence;
    struct zmk_ptp_frame resumed = last(&resumed_sequence);
    zassert_equal(resumed_sequence, (uint16_t)(sequence + 1));
    zassert_equal(resumed.contact_count, 0);
    zassert_equal(resumed.buttons, 0);
    k_sleep(K_MSEC(160));
    int idle_count = count;
    k_sleep(K_MSEC(160));
    zassert_equal(count, idle_count); /* No permanent idle radio traffic. */
}

ZTEST(ptp_peripheral, test_failed_admission_and_validation) {
    struct zmk_ptp_frame frame = one();
    error = -ENOSPC;
    zassert_equal(zmk_ptp_submit_frame(&frame), -ENOSPC);
    error = 0;
    k_sleep(K_MSEC(70)); /* Latest physical snapshot is retried. */
    uint16_t sequence;
    zassert_equal(last(&sequence).contacts[0].x, 123);
    int accepted = count;
    frame.contact_count = 6;
    zassert_equal(zmk_ptp_submit_frame(&frame), -EINVAL);
    zassert_equal(zmk_ptp_submit_frame(NULL), -EINVAL);
    zassert_equal(count, accepted);
}

ZTEST(ptp_peripheral, test_retry_preserves_observation_sequence) {
    struct zmk_ptp_frame frame = one();
    zassert_ok(zmk_ptp_submit_frame(&frame));
    uint16_t initial, retried;
    last(&initial);
    frame.scan_time++;
    frame.contacts[0].x++;
    error = -ENOSPC;
    zassert_equal(zmk_ptp_submit_frame(&frame), -ENOSPC);
    error = 0;
    zassert_ok(zmk_ptp_submit_frame(&frame));
    last(&retried);
    zassert_equal(retried, (uint16_t)(initial + 1));
    zassert_ok(zmk_ptp_submit_frame(&frame));
    last(&initial);
    zassert_equal(initial, retried);
    frame.contact_count = 0;
    error = -ENODEV;
    zassert_equal(zmk_ptp_submit_frame(&frame), -ENODEV);
    error = 0;
    zassert_ok(zmk_ptp_submit_frame(&frame));
    zassert_equal(last(&initial).contact_count, 0);
    zassert_equal(initial, (uint16_t)(retried + 1));
}

static void from_isr(const void *unused) {
    struct zmk_ptp_frame frame = one();
    zassert_equal(zmk_ptp_submit_frame(&frame), -EWOULDBLOCK);
    zassert_equal(zmk_ptp_release(), -EWOULDBLOCK);
}

ZTEST(ptp_peripheral, test_isr_rejected) {
    irq_offload(from_isr, NULL);
    zassert_equal(count, 0);
}

ZTEST_SUITE(ptp_peripheral, NULL, NULL, before, NULL, NULL);
```

## src/queue.c
```c
/*
 * Copyright (c) 2026 The ZMK Contributors
 * SPDX-License-Identifier: MIT
 */
#include <errno.h>
#include <zephyr/ztest.h>
#include <zmk/ptp/queue.h>
#include <zmk/ptp/frame.h>
#include <zmk/ptp/transport.h>
#include "hog.h"
#include "test_source.h"
#include <zephyr/sys/byteorder.h>

struct item {
    struct zmk_ptp_queue_header header;
    int position;
};
K_MSGQ_DEFINE(queue, sizeof(struct item), 4, 4);
static uint32_t ticket;

static int put(int position, uint16_t state, bool motion) {
    uint32_t next = ++ticket;
    struct item item = {.header = {.ticket = next,
                                   .state = state,
                                   .first_sequence = next,
                                   .motion = motion},
                        .position = position},
                scratch;
    return zmk_ptp_queue_put(&queue, &item, &scratch);
}

static void before(void *fixture) {
    k_msgq_purge(&queue);
    ticket = 0;
}

ZTEST(ptp_queue, test_transition_then_latest_motion) {
    zassert_ok(put(1, 1, false)); /* Initial down is an immutable anchor. */
    zassert_ok(put(2, 1, true));
    for (int i = 3; i <= 100; i++) {
        zassert_equal(put(i, 1, true), 1);
    }
    zassert_equal(k_msgq_num_used_get(&queue), 2);
    struct item item;
    zassert_ok(k_msgq_get(&queue, &item, K_NO_WAIT));
    zassert_equal(item.position, 1);
    zassert_ok(k_msgq_get(&queue, &item, K_NO_WAIT));
    zassert_equal(item.position, 100);
    zassert_equal(item.header.first_sequence, 2); /* Coverage includes all replaced motion. */
}

ZTEST(ptp_queue, test_lift_retouch_and_full_queue) {
    zassert_ok(put(1, 1, false));
    zassert_ok(put(2, 1, true));
    zassert_ok(put(3, 0, false)); /* Lift. */
    zassert_ok(put(4, 1, false)); /* Re-touch of same ID is not the old lifetime. */
    zassert_equal(put(5, 1, true), -ENOMSG);
    for (int i = 1; i <= 4; i++) {
        struct item item;
        zassert_ok(k_msgq_get(&queue, &item, K_NO_WAIT));
        zassert_equal(item.position, i);
    }
}

ZTEST(ptp_queue, test_full_queue_can_replace_motion_but_not_cross_state) {
    for (int i = 1; i <= 3; i++) {
        zassert_ok(put(i, i, false));
    }
    zassert_ok(put(4, 3, true));
    zassert_equal(put(5, 3, true), 1);
    zassert_equal(put(6, 4, true), -ENOMSG);
    struct item item;
    for (int i = 1; i <= 3; i++) {
        zassert_ok(k_msgq_get(&queue, &item, K_NO_WAIT));
        zassert_equal(item.position, i);
    }
    zassert_ok(k_msgq_get(&queue, &item, K_NO_WAIT));
    zassert_equal(item.position, 5);
}

ZTEST(ptp_queue, test_unlocked_head_overwrite_does_not_dequeue_new_observation) {
    zassert_ok(put(1, 1, true));
    struct item copied, removed;
    zassert_ok(k_msgq_peek(&queue, &copied));
    zassert_equal(put(2, 1, true), 1); /* Arrives while the old copy is being sent. */
    zassert_false(zmk_ptp_queue_get(&queue, copied.header.ticket, &removed));
    zassert_ok(k_msgq_peek(&queue, &copied));
    zassert_equal(copied.position, 2);
    zassert_true(zmk_ptp_queue_get(&queue, copied.header.ticket, &removed));
    zassert_equal(removed.position, 2);
    zassert_ok(put(3, 1, false));
    zassert_ok(k_msgq_peek(&queue, &copied));
    zassert_ok(put(4, 1, true)); /* Appending a tail must not invalidate the head. */
    zassert_true(zmk_ptp_queue_get(&queue, copied.header.ticket, &removed));
    zassert_equal(removed.position, 3);
}

ZTEST(ptp_queue, test_sender_coverage_cannot_bridge_failed_admission) {
    struct item old = {
        .header = {.ticket = 1, .state = 1, .motion = true, .first_sequence = 10, .sequence = 10},
        .position = 10};
    struct item next = {
        .header = {.ticket = 2, .state = 1, .motion = true, .first_sequence = 12, .sequence = 12},
        .position = 12};
    struct item scratch;
    zassert_ok(zmk_ptp_queue_put(&queue, &old, &scratch));
    /* Observation 11 could have been a failed lift; never mark it covered. */
    zassert_ok(zmk_ptp_queue_put(&queue, &next, &scratch));
    zassert_equal(k_msgq_num_used_get(&queue), 2);
    zassert_ok(k_msgq_get(&queue, &scratch, K_NO_WAIT));
    zassert_equal(scratch.header.first_sequence, 10);
    zassert_ok(k_msgq_get(&queue, &scratch, K_NO_WAIT));
    zassert_equal(scratch.header.first_sequence, 12);
    old.header.sequence = 0xffff;
    old.header.first_sequence = 0xfffe;
    next.header.sequence = 0;
    next.header.first_sequence = 0;
    zassert_ok(zmk_ptp_queue_put(&queue, &old, &scratch));
    zassert_equal(zmk_ptp_queue_put(&queue, &next, &scratch), 1);
    zassert_ok(k_msgq_get(&queue, &scratch, K_NO_WAIT));
    zassert_equal(scratch.header.first_sequence, 0xfffe);
}

ZTEST(ptp_queue, test_hid_and_source_state_ignore_coordinates_not_lifts) {
    struct zmk_ptp_frame f = {
        .contact_count = 1, .contacts = {{.id = 3, .confidence = true}}, .buttons = 5};
    struct zmk_ptp_report r = {
        .count_buttons = 1 | (5 << 4),
        .contacts = {{.flags_id = (3 << 2) | ZMK_PTP_TIP | ZMK_PTP_CONFIDENCE}}};
    bool lift;
    uint16_t state = zmk_ptp_report_state(&r, &lift);
    zassert_false(lift);
    zassert_equal(state, zmk_ptp_frame_state(&f));
    r.contacts[0].x = 100;
    r.scan_time = 200;
    zassert_equal(state, zmk_ptp_report_state(&r, &lift));
    r.contacts[0].flags_id &= ~ZMK_PTP_CONFIDENCE;
    zassert_not_equal(state, zmk_ptp_report_state(&r, &lift));
    r.contacts[0].flags_id &= ~ZMK_PTP_TIP;
    zmk_ptp_report_state(&r, &lift);
    zassert_true(lift);
    f.contact_count = 2;
    f.contacts[1] = f.contacts[0];
    f.contacts[1].id = 1;
    uint16_t a = zmk_ptp_frame_state(&f);
    struct zmk_ptp_contact swap = f.contacts[0];
    f.contacts[0] = f.contacts[1];
    f.contacts[1] = swap;
    zassert_equal(a, zmk_ptp_frame_state(&f)); /* Order does not create a fake transition. */
}

ZTEST(ptp_queue, test_compact_lengths_and_sequence_coverage_wrap) {
    struct zmk_ptp_split_frame wire, decoded;
    struct zmk_ptp_frame f = {0}, received;
    uint16_t seq;
    for (int n = 0; n <= 5; n++) {
        f.contact_count = n;
        for (int i = 0; i < n; i++) {
            f.contacts[i] = (struct zmk_ptp_contact){.id = i, .confidence = true};
        }
        zmk_ptp_split_encode(&wire, 1, &f);
        wire.first_sequence = sys_cpu_to_le16(0xfffc);
        size_t size = 7 + 5 * n;
        zassert_equal(zmk_ptp_split_size(&wire), size);
        zassert_ok(zmk_ptp_split_unpack(&decoded, &wire, size));
        uint8_t packet[sizeof(wire) + 1] __aligned(2);
        memcpy(packet + 1, &wire, size); /* Received ATT values need not be aligned. */
        zassert_ok(zmk_ptp_split_unpack(&decoded, packet + 1, size));
        zassert_mem_equal(&decoded, &wire, sizeof(wire));
        zassert_ok(zmk_ptp_split_decode(&decoded, &seq, &received));
        zassert_equal(received.contact_count, n);
        zassert_equal(zmk_ptp_split_unpack(&decoded, &wire, size - 1), -EINVAL);
        if (n < 5) {
            zassert_equal(zmk_ptp_split_unpack(&decoded, &wire, size + 1), -EINVAL);
        }
    }
    zassert_equal(zmk_ptp_split_unpack(&decoded, NULL, 7), -EINVAL);
    zassert_equal(zmk_ptp_split_unpack(&decoded, &wire, 33), -EINVAL);
    wire.first_sequence = sys_cpu_to_le16(2); /* Coverage cannot begin in the future. */
    zassert_equal(zmk_ptp_split_decode(&wire, &seq, &received), -EINVAL);
    wire.count_buttons = 0x80;
    zassert_equal(zmk_ptp_split_unpack(&decoded, &wire, 7), -EINVAL);
    wire.count_buttons = 6;
    zassert_equal(zmk_ptp_split_unpack(&decoded, &wire, 32), -EINVAL);
}

ZTEST(ptp_queue, test_motion_pace_and_transition_bypass) {
    int64_t last = 100;
    zassert_equal(zmk_ptp_pace_wait(false, true, last, last, 7500), 0);
    zassert_equal(zmk_ptp_pace_wait(true, false, last, last, 7500), 0);
#if IS_ENABLED(CONFIG_ZMK_BLE_PTP_PACING)
    k_ticks_t period = k_us_to_ticks_ceil64(7500 + CONFIG_ZMK_BLE_PTP_PACE_MARGIN_US);
    zassert_equal(zmk_ptp_pace_wait(true, true, last, last, 7500), period);
    zassert_equal(zmk_ptp_pace_wait(true, true, last, last + period - 1, 7500), 1);
    zassert_equal(zmk_ptp_pace_wait(true, true, last, last + period, 7500), 0);
    zassert_equal(zmk_ptp_pace_wait(true, true, last, last + period + 1, 7500), 0);
    zassert_equal(zmk_ptp_pace_wait(true, true, last, last + period + 100000, 7500), 0);
    zassert_equal(zmk_ptp_pace_wait(true, true, last, last, 15000),
                  k_us_to_ticks_ceil64(15000 + CONFIG_ZMK_BLE_PTP_PACE_MARGIN_US));
    zassert_equal(zmk_ptp_pace_wait(true, true, last, last, 0),
                  k_us_to_ticks_ceil64(CONFIG_ZMK_BLE_PTP_PACE_FALLBACK_US));
#else
    zassert_equal(zmk_ptp_pace_wait(true, true, last, last, 7500), 0);
#endif
}

ZTEST(ptp_queue, test_synthetic_strokes_and_lifetime_boundaries) {
    for (uint32_t step = 0; step < 900; step++) {
        struct zmk_ptp_frame f = zmk_ptp_test_frame(step);
        zassert_ok(zmk_ptp_validate_frame(&f));
        zassert_equal(f.scan_time, (uint16_t)(step * 100));
        uint32_t phase = step % 450;
        if (phase < 100) {
            zassert_equal(f.contact_count, 1);
            zassert_equal(f.contacts[0].y, CONFIG_ZMK_TRACKPAD_LOGICAL_Y / 2);
        } else if (phase >= 150 && phase < 250) {
            zassert_equal(f.contact_count, 1);
            zassert_equal(f.contacts[0].x, CONFIG_ZMK_TRACKPAD_LOGICAL_X / 2);
        } else if (phase >= 300 && phase < 400) {
            zassert_equal(f.contact_count, 2);
            zassert_equal(f.contacts[0].x + f.contacts[1].x, CONFIG_ZMK_TRACKPAD_LOGICAL_X);
            zassert_equal(f.contacts[0].y + f.contacts[1].y, CONFIG_ZMK_TRACKPAD_LOGICAL_Y);
        } else {
            zassert_equal(f.contact_count, 0);
        }
    }
}

ZTEST_SUITE(ptp_queue, NULL, NULL, before, NULL, NULL);
```
